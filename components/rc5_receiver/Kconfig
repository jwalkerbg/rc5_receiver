## components/rc5_receiver/Kconfig
```kconfig
menu "RC5 Receiver Configuration"

    config RC5_RECEIVER
        bool "Enable RC5 Receiver support"
        default y
        help
            Enable support for RC5 receiver using RMT module.

    if RC5_RECEIVER

        config RC5_RECEIVER_VERSION
            string "RC5 Receiver Version"
            default "2.0.0"
            help
                Define the version of the RC5 Receiver component.

        config RC5_RX_GPIO
            int "RC5 Receiver GPIO Pin"
            default 4
            range 0 39
            help
                GPIO pin used for RC5 receiver input.

        config RC5_INVERT_IN
            bool "Invert RC5 Input Signal"
            default y
            help
                If enabled, the input signal will be inverted.

        config RMT_CLK_RES_HZ
            int "RMT Clock Resolution (Hz)"
            default 1000000
            help
                Clock resolution for the RMT peripheral, default is 1 MHz (1 μs resolution).

        config RC5_BUFFER_SIZE
            int "RC5 Buffer Size"
            default 64
            range 20 64
            help
                Number of symbols in the RC5 receive buffer.

        config RC5_SYMBOL_DURATION_US
            int "RC5 Symbol Duration (μs)"
            default 899
            help
                Duration of a single RC5 symbol in microseconds.

        config RC5_TOLERANCE_US
            int "RC5 Tolerance (μs)"
            default 200
            help
                Tolerance for signal duration in microseconds.

        config RC5_LONG_PRESS_THRESHOLD
            int "Long Press Threshold"
            default 5
            help
                Threshold value to determine how long a button must be pressed to be considered a long press. This is the number of RC5 frames that must be received before a long press is detected.

        config RC5_FRAME_INTERVAL
            int "RC5 Frame Interval (ms)"
            default 107
            help
                Interval in milliseconds between RC5 frames.
    endif

endmenu
```

## sdkconfig.defaults
```kconfig
CONFIG_RMT_ISR_IRAM_SAFE=y
CONFIG_RMT_RECV_FUNC_IN_IRAM=y
CONFIG_RMT_ENABLE_DEBUG_LOG=y
```
